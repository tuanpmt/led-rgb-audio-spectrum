#include <string.h>
#include "led.h"
#include "tick.h"
#include "hw_config.h"


U8 maxBar[32];
U8 maxPoints[32];
U32 activeDownBar = 0;

void SPI_Write(U16 data);


U8 pwmFrm = 0;
U8 bufNo = 0;
U16 ScanBuf[2][16][96];

U8 yB[] = {16, 22, 28, 12, 6, 0, 52, 58, 46, 40, 34, 82, 88, 94, 74, 68};
U8 yG[] = {18, 26, 30,  8, 2, 50, 54, 62, 44, 38, 32, 86, 92, 76, 70, 64};
U8 yR[] = {20, 24, 14,  10, 4, 48, 56, 60, 42, 36, 80, 84, 90, 78, 72, 66};
U32 bitMap[] = {1, 2, 4, 8, 16, 32, 64, 128, 256, 512, 1024, 2048, 4096, 8192, 16384, 32768, 65536, 131072, 262144, 524288, 1048576, 2097152, 4194304, 8388608, 16777216, 33554432, 67108864, 134217728, 268435456, 536870912, 1073741824,	2147483648};
U8 color[3], colorIdx = 0;
const U8 bmp[] = {0x01, 0x03, 0x03, 0x00, 0x03, 0x03, 0x00, 0x04, 0x03, 0x00, 0x04, 0x04, 0x00,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 0x02, 0x02};
void LED_Init(void)
{
	U8 xx, yy;
	U16  adr;
	GPIO_InitTypeDef GPIO_InitStructure;
	TIM_TimeBaseInitTypeDef TIM_TimeBaseStructure;
	SPI_InitTypeDef SPI_InitStruct;
	
	RCC_APB2PeriphClockCmd(RCC_APB2Periph_GPIOB | RCC_APB2Periph_GPIOA | RCC_APB2Periph_SPI1, ENABLE);

	GPIO_InitStructure.GPIO_Pin = GPIO_Pin_5 | GPIO_Pin_7 ;
	GPIO_InitStructure.GPIO_Mode = GPIO_Mode_AF_PP;
	GPIO_InitStructure.GPIO_Speed = GPIO_Speed_50MHz;
	GPIO_Init(GPIOA, &GPIO_InitStructure);
								   
	GPIO_InitStructure.GPIO_Pin = GPIO_Pin_8;
	GPIO_InitStructure.GPIO_Mode = GPIO_Mode_Out_PP;
	GPIO_InitStructure.GPIO_Speed = GPIO_Speed_50MHz;
	GPIO_Init(GPIOA, &GPIO_InitStructure);
	
	GPIO_InitStructure.GPIO_Pin = GPIO_Pin_12 | GPIO_Pin_0;
	GPIO_InitStructure.GPIO_Mode = GPIO_Mode_Out_PP;
	GPIO_InitStructure.GPIO_Speed = GPIO_Speed_50MHz;
	GPIO_Init(GPIOB, &GPIO_InitStructure);
	
	SPI_InitStruct.SPI_Direction = SPI_Direction_1Line_Tx; // set to full duplex mode, seperate MOSI and MISO lines
	SPI_InitStruct.SPI_Mode = SPI_Mode_Master;     // transmit in master mode, NSS pin has to be always high
	SPI_InitStruct.SPI_DataSize = SPI_DataSize_16b; // one packet of data is 8 bits wide
	SPI_InitStruct.SPI_CPOL = SPI_CPOL_Low;        // clock is low when idle
	SPI_InitStruct.SPI_CPHA = SPI_CPHA_1Edge;      // data sampled at first edge
	SPI_InitStruct.SPI_NSS = SPI_NSS_Soft | SPI_NSSInternalSoft_Set; // set the NSS management to internal and pull internal NSS high
	SPI_InitStruct.SPI_BaudRatePrescaler = SPI_BaudRatePrescaler_8; // SPI frequency is APB2 frequency / 4
	SPI_InitStruct.SPI_FirstBit = SPI_FirstBit_LSB;// data is transmitted MSB first
	SPI_Init(SPI1, &SPI_InitStruct); 
	
	SPI_Cmd(SPI1, ENABLE); // enable SPI1
	
	RCC_APB1PeriphClockCmd(RCC_APB1Periph_TIM3, ENABLE);
		/* Time base configuration */
  TIM_TimeBaseStructInit(&TIM_TimeBaseStructure);
  TIM_TimeBaseStructure.TIM_Period = 6; // 1000 Hz = 10 000/10
  TIM_TimeBaseStructure.TIM_Prescaler = 7099;
  TIM_TimeBaseStructure.TIM_ClockDivision = 0;
  TIM_TimeBaseStructure.TIM_CounterMode = TIM_CounterMode_Up;
	
  TIM_TimeBaseInit(TIM3, &TIM_TimeBaseStructure);
	TIM_ITConfig(TIM3, TIM_IT_Update, ENABLE);
	NVIC_Config(TIM3_IRQn, 2, ENABLE);
	
	memset(ScanBuf, 0x00, sizeof(ScanBuf));
  /* TIM2 enable counter */
  TIM_Cmd(TIM3, ENABLE);
	
	LED_SCK_L();
	LED_SLE_L();
	LED_CK_L();
	LED_LE_L();
	adr = 0;
	for(xx=0; xx<32; xx++){
		for(yy=0; yy<16; yy++){
			LED_WritePixel(xx, yy, bmp[adr], bmp[adr+1],bmp[adr+2]);
			adr += 3;
		}
	}
	bufNo = 1-bufNo;

	//while(1);
}


void LED_WritePixel(U8 x, U8 y, U8 R, U8 G, U8 B)
{
	U32 *ptrR, *ptrG, *ptrB;
	U8 i, byteR, byteG, byteB;
	byteR = yR[y];
	byteG = yG[y];
	byteB = yB[y];
	for(i=0; i<16; i++) {
		ptrR = (U32*)&ScanBuf[1-bufNo][i][byteR];
		ptrG = (U32*)&ScanBuf[1-bufNo][i][byteG];
		ptrB = (U32*)&ScanBuf[1-bufNo][i][byteB];
		if(R > i){
			*ptrR |= bitMap[x];
		} else {
			*ptrR &= (bitMap[x] ^ 0xFFFFFFFF);
		}
		if(G > i){
			*ptrG |= bitMap[x];
		} else {
			*ptrG &= (bitMap[x] ^ 0xFFFFFFFF);
		}
		if(B > i){
			*ptrB |= bitMap[x];
		} else {
			*ptrB &= (bitMap[x] ^ 0xFFFFFFFF);
		}
	}
}

void SPI_Write(U16 data)
{
	SPI1->DR = data; // write data to be transmitted to the SPI data register
	while( !(SPI1->SR & SPI_I2S_FLAG_TXE) ); // wait until transmit complete
	while( SPI1->SR & SPI_I2S_FLAG_BSY );
}

void TIM3_IRQHandler(void)
{
	U8 i;
	if (TIM_GetITStatus(TIM3, TIM_IT_Update) != RESET)
  {
		for(i = 0; i < 96;){
			SPI_Write(ScanBuf[bufNo][pwmFrm][i++]);
			SPI_Write(ScanBuf[bufNo][pwmFrm][i++]);
			LED_SLE_H();
			LED_SLE_L();
			LED_CK_H();
			LED_CK_L();
		}
		LED_LE_H();
		LED_LE_L();
		pwmFrm ++;
		pwmFrm &= 0x0F;
    /* Clear TIM2 update interrupt */
    TIM_ClearITPendingBit(TIM3, TIM_IT_Update);
		activeDownBar ++;
	}
}
void LED_Colorful(void)
{
	U8 i, j;
	memset(&ScanBuf[1-bufNo], 0x00, sizeof ScanBuf[1-bufNo]);

		for(i=0; i<32; i++){
			for(j=0; j<maxBar[i]; j++) {

						LED_WritePixel(i, j, maxBar[4], i/2, maxBar[20]);
			}
			
		}
		bufNo = 1-bufNo;
}
void LED_Bar(void)
{
	U8 i, j;
	memset(&ScanBuf[1-bufNo], 0x00, sizeof ScanBuf[1-bufNo]);

		for(i=0; i<32; i++){
			for(j=0; j<maxBar[i]; j++) {

				LED_WritePixel(i, j, 15-maxBar[20], maxBar[10] , j);
				//LED_WritePixel(i, j, 15-maxBar[j], maxBar[i] , j);
			}
			
		}
		bufNo = 1-bufNo;
}
void LED_Manage(void)
{
	U8 i, j;
	
	if(activeDownBar > 112){
		activeDownBar = 0;
		for(i=0; i<32; i++){
			if(maxBar[i] > 0)
				maxBar[i] --;
		}
	}
	if(activeDownBar % 8 == 0){
		LED_Bar();
//		memset(&ScanBuf[1-bufNo], 0x00, sizeof ScanBuf[1-bufNo]);
//		for(i=0; i<32; i++){
//			for(j=0; j<maxBar[i]; j++) {
////					if(j == maxBar[i] - 1) {
////						LED_WritePixel(i, j, 15, 0, 0);
////						
//					//}//else if(j == maxBar[i] - 2) {
////						LED_WritePixel(i, j, 7, 0, 0);
////						
////					} else if(j == maxBar[i] - 3) {
////						LED_WritePixel(i, j, 15, 0, 0);
//////						
////					}else
//						LED_WritePixel(i, j, 15-j, j, i/2);
//			}
//			
//		}
//		bufNo = 1-bufNo;
	}
}
void LED_SetMax(U8 col, U8 val)
{
	U8 i;
	if(val > maxBar[col]){
		if(col < 31)
			if(maxBar[col+1] < val)
				maxBar[col+1]++;
		maxBar[col] = val;
		maxPoints[col] = val;
		if(col > 0)
			if(maxBar[col+1] < val)
				maxBar[col+1]++;
//		
	}
}